## configs/okamaos_x86_64_defconfig
```kconfig
# OkamaOS x86_64 defconfig (Buildroot)
#
# This is a minimal, console-grade base. It pulls Linux + BusyBox + Python3 +
# SDL2/pygame stack + ALSA + BlueZ. No X11, no Wayland, no desktop shells.
#
# Place this file at $(BR_DIR)/configs/okamaos_x86_64_defconfig (the root
# Makefile copies it for you), then run:
#   make -C buildroot O=output okamaos_x86_64_defconfig

# --- Architecture ---
BR2_x86_64=y
BR2_x86_nocona=y

# --- Toolchain ---
BR2_TOOLCHAIN_BUILDROOT_GLIBC=y
BR2_TOOLCHAIN_BUILDROOT_CXX=y

# --- Init / system ---
BR2_INIT_BUSYBOX=y
BR2_SYSTEM_BIN_SH_BASH=y
BR2_TARGET_GENERIC_HOSTNAME="okamaos"
BR2_TARGET_GENERIC_ISSUE="OkamaOS"
BR2_TARGET_GENERIC_GETTY_PORT="tty2"
BR2_ROOTFS_OVERLAY="$(BR2_EXTERNAL_OKAMAOS_PATH)/board/okamaos/rootfs-overlay"
BR2_ROOTFS_DEVICE_TABLE="$(BR2_EXTERNAL_OKAMAOS_PATH)/board/okamaos/device_table.txt"
BR2_ROOTFS_POST_BUILD_SCRIPT="$(BR2_EXTERNAL_OKAMAOS_PATH)/board/okamaos/post-build.sh"
BR2_ROOTFS_POST_IMAGE_SCRIPT="$(BR2_EXTERNAL_OKAMAOS_PATH)/board/okamaos/post-image.sh"

# --- Kernel ---
BR2_LINUX_KERNEL=y
BR2_LINUX_KERNEL_CUSTOM_VERSION=y
BR2_LINUX_KERNEL_CUSTOM_VERSION_VALUE="6.6.30"
BR2_LINUX_KERNEL_USE_CUSTOM_CONFIG=y
BR2_LINUX_KERNEL_CUSTOM_CONFIG_FILE="$(BR2_EXTERNAL_OKAMAOS_PATH)/board/okamaos/linux.config"
BR2_LINUX_KERNEL_BZIMAGE=y

# --- BusyBox ---
BR2_PACKAGE_BUSYBOX_CONFIG="$(BR2_EXTERNAL_OKAMAOS_PATH)/board/okamaos/busybox.config"

# --- Filesystem ---
BR2_TARGET_ROOTFS_EXT2=y
BR2_TARGET_ROOTFS_EXT2_4=y
BR2_TARGET_ROOTFS_EXT2_SIZE="768M"
BR2_TARGET_ROOTFS_SQUASHFS=y

# --- Bootloader ---
BR2_TARGET_SYSLINUX=y
BR2_TARGET_SYSLINUX_ISOLINUX=y

# --- Python + game runtime ---
BR2_PACKAGE_PYTHON3=y
BR2_PACKAGE_PYTHON3_PY_PYC=y
BR2_PACKAGE_PYTHON_PIP=y
# NOTE: pygame removed from Buildroot 2024.02; okama-runtime installs pygame==2.5.2
#       from PyPI via the host pip3 during post-install (requires network at build time)
BR2_PACKAGE_SDL2=y
BR2_PACKAGE_SDL2_IMAGE=y
BR2_PACKAGE_SDL2_MIXER=y
BR2_PACKAGE_SDL2_TTF=y

# --- Input / device handling ---
BR2_PACKAGE_EUDEV=y
BR2_PACKAGE_LIBEVDEV=y
BR2_PACKAGE_LIBINPUT=y
BR2_PACKAGE_EVTEST=y
BR2_PACKAGE_LINUXCONSOLETOOLS_JOYSTICK=y

# --- Bluetooth ---
BR2_PACKAGE_BLUEZ5_UTILS=y
BR2_PACKAGE_BLUEZ5_UTILS_CLIENT=y
BR2_PACKAGE_BLUEZ5_UTILS_TOOLS=y
BR2_PACKAGE_BLUEZ5_UTILS_DEPRECATED=y
BR2_PACKAGE_BLUEZ5_UTILS_PLUGINS_HID=y
BR2_PACKAGE_BLUEZ5_UTILS_PLUGINS_HOG=y
BR2_PACKAGE_BLUEZ5_UTILS_TOOLS_HID2HCI=y

# --- Hardware firmware / diagnostics ---
BR2_PACKAGE_PCIUTILS=y
BR2_PACKAGE_USBUTILS=y
BR2_PACKAGE_UTIL_LINUX=y
BR2_PACKAGE_UTIL_LINUX_RFKILL=y
BR2_PACKAGE_LINUX_FIRMWARE=y
BR2_PACKAGE_LINUX_FIRMWARE_I915=y
BR2_PACKAGE_LINUX_FIRMWARE_AMDGPU=y
BR2_PACKAGE_LINUX_FIRMWARE_RADEON=y
BR2_PACKAGE_LINUX_FIRMWARE_IBT=y
BR2_PACKAGE_LINUX_FIRMWARE_RTL_87XX_BT=y
BR2_PACKAGE_LINUX_FIRMWARE_RTL_88XX_BT=y
BR2_PACKAGE_LINUX_FIRMWARE_QUALCOMM_6174A_BT=y
BR2_PACKAGE_LINUX_FIRMWARE_QUALCOMM_9377_BT=y
BR2_PACKAGE_LINUX_FIRMWARE_AR3011=y
BR2_PACKAGE_LINUX_FIRMWARE_AR3012_USB=y
BR2_PACKAGE_LINUX_FIRMWARE_IWLWIFI_22000=y
BR2_PACKAGE_LINUX_FIRMWARE_IWLWIFI_22260=y
BR2_PACKAGE_LINUX_FIRMWARE_IWLWIFI_3160=y
BR2_PACKAGE_LINUX_FIRMWARE_IWLWIFI_3168=y
BR2_PACKAGE_LINUX_FIRMWARE_IWLWIFI_7260=y
BR2_PACKAGE_LINUX_FIRMWARE_IWLWIFI_7265D=y
BR2_PACKAGE_LINUX_FIRMWARE_IWLWIFI_8000C=y
BR2_PACKAGE_LINUX_FIRMWARE_IWLWIFI_8265=y
BR2_PACKAGE_LINUX_FIRMWARE_IWLWIFI_9XXX=y
BR2_PACKAGE_LINUX_FIRMWARE_IWLWIFI_6E=y
BR2_PACKAGE_LINUX_FIRMWARE_IWLWIFI_QUZ=y
BR2_PACKAGE_LINUX_FIRMWARE_RTL_81XX=y
BR2_PACKAGE_LINUX_FIRMWARE_RTL_87XX=y
BR2_PACKAGE_LINUX_FIRMWARE_RTL_88XX=y
BR2_PACKAGE_LINUX_FIRMWARE_RTL_RTW88=y
BR2_PACKAGE_LINUX_FIRMWARE_RTL_RTW89=y
BR2_PACKAGE_LINUX_FIRMWARE_ATHEROS_9271=y
BR2_PACKAGE_LINUX_FIRMWARE_ATHEROS_10K_QCA9377=y
BR2_PACKAGE_LINUX_FIRMWARE_MEDIATEK_MT7601U=y
BR2_PACKAGE_LINUX_FIRMWARE_MEDIATEK_MT7921=y
BR2_PACKAGE_LINUX_FIRMWARE_MEDIATEK_MT7921_BT=y
BR2_PACKAGE_LINUX_FIRMWARE_MEDIATEK_MT7922=y
BR2_PACKAGE_LINUX_FIRMWARE_MEDIATEK_MT7922_BT=y
BR2_PACKAGE_LINUX_FIRMWARE_BRCM_BCM43XX=y
BR2_PACKAGE_LINUX_FIRMWARE_BRCM_BCM43XXX=y
BR2_PACKAGE_LINUX_FIRMWARE_RTL_815X=y
BR2_PACKAGE_LINUX_FIRMWARE_RTL_8169=y
BR2_PACKAGE_LINUX_FIRMWARE_BROADCOM_TIGON3=y

# --- Additional USB WiFi/Bluetooth adapter support (verified symbols for Buildroot 2024.02.10) ---
BR2_PACKAGE_LINUX_FIRMWARE_CYPRESS_CYW43XXX=y
BR2_PACKAGE_LINUX_FIRMWARE_RALINK_RT2XX=y
BR2_PACKAGE_LINUX_FIRMWARE_RALINK_RT73=y
BR2_PACKAGE_LINUX_FIRMWARE_MEDIATEK_MT7610E=y
BR2_PACKAGE_LINUX_FIRMWARE_MEDIATEK_MT7650=y
BR2_PACKAGE_LINUX_FIRMWARE_BRCM_BCM4366B1=y
BR2_PACKAGE_LINUX_FIRMWARE_BRCM_BCM4366C0=y

# --- Audio ---
BR2_PACKAGE_ALSA_LIB=y
BR2_PACKAGE_ALSA_UTILS=y
BR2_PACKAGE_ALSA_UTILS_AMIXER=y
BR2_PACKAGE_ALSA_UTILS_APLAY=y
BR2_PACKAGE_ALSA_UTILS_ALSACTL=y

# --- Networking ---
BR2_PACKAGE_DROPBEAR=y
BR2_PACKAGE_DROPBEAR_DISABLE_REVERSEDNS=y
BR2_PACKAGE_CA_CERTIFICATES=y
BR2_PACKAGE_IW=y
BR2_PACKAGE_WIRELESS_TOOLS=y
BR2_PACKAGE_WPA_SUPPLICANT=y
BR2_PACKAGE_WPA_SUPPLICANT_CLI=y
BR2_PACKAGE_WPA_SUPPLICANT_PASSPHRASE=y
BR2_PACKAGE_DHCPCD=y

# --- Fonts / font discovery ---
BR2_PACKAGE_FONTCONFIG=y

# --- Filesystem utilities ---
BR2_PACKAGE_E2FSPROGS=y
BR2_PACKAGE_E2FSPROGS_FSCK=y

# --- Compression for .ok packages ---
BR2_PACKAGE_ZSTD=y

# --- OkamaOS userland (BR2_EXTERNAL package) ---
BR2_PACKAGE_OKAMA_RUNTIME=y
```

## package/okama-runtime/Config.in
```kconfig
config BR2_PACKAGE_OKAMA_RUNTIME
	bool "okama-runtime (OkamaOS userland)"
	default y
	select BR2_PACKAGE_PYTHON3
	help
	  OkamaOS userland: okama-shell, okama-cli, okama-run, okama-pack,
	  okama-inputd, okama-agent, okama-store, okama-update,
	  okama-snapshot.
```
